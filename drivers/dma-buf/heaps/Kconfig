## drivers/dma-buf/heaps/Kconfig
```kconfig
config DMABUF_HEAPS_SYSTEM
	bool "DMA-BUF System Heap"
	depends on DMABUF_HEAPS
	help
	  Choose this option to enable the system dmabuf heap. The system heap
	  is backed by pages from the buddy allocator. If in doubt, say Y.
	  Leave this off if you only need vendor heaps such as mtk_mm: userspace
	  that finds /dev/dma_heap/system will start preferring it over ION.
```
